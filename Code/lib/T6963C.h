/********************************************************************************************************
- FB-EDU-PARM-LPC2138 User Function file
- Author: Kruck Wang(Luo XieBing )
- Date: 2009-04-23
- Guangzhou Windway Electronic Technology Co., Ltd.
- Date: 2010-10-29
- Labcenter Electronics Ltd.
********************************************************************************************************/

/****************************************************************************
* Filename: T6963C.h
* Description: T6963C driver
****************************************************************************/
#include "Config.h"
#include "Target.h"
#include <string.h>
#define width      16       //Display width
#define addr_w     0x0000   //Text display buffer base address
#define addr_t     0x0100   //Graphics display buffer base address

// T6963C Pin definition
#define fs  (1<<8)
#define cd  (1<<12)
#define ce  (1<<13)
#define rd  (1<<10)
#define wr  (1<<14)
#define rst (1<<9)
#define bf0  (1<<0)
#define bf1  (1<<1)
#define bf3  (1<<3)

// Function declare
void wr_comm (uint8 comm);
void wr_data (uint8 dat);
void chk_busy (uint8 autowr);

typedef struct typFNT_GB16 // Chinese font structure
 { char Index[2];    // font index
   char Msk[32];     // font table
 } typFNT_GB16;

struct typFNT_GB16 const GB_16[] =          // Windway Font table
 { "?", 0x01,0x00,0x00,0x84,0x3F,0xFE,0x20,0x00,
         0x20,0x00,0x20,0x00,0x20,0x00,0x20,0x00,
         0x20,0x00,0x20,0x00,0x20,0x00,0x20,0x00,
         0x40,0x00,0x40,0x00,0x80,0x00,0x00,0x00,

   "?", 0x10,0x04,0x10,0x84,0x10,0x84,0x10,0x84,
         0x54,0xA4,0x52,0x94,0x52,0x94,0x90,0x84,
         0x10,0x84,0x10,0x84,0x10,0x84,0x10,0x84,
         0x20,0x84,0x20,0x84,0x40,0x04,0x00,0x04,

   "?", 0x00,0x10,0x3F,0xF8,0x20,0x10,0x28,0x50,
         0x24,0x50,0x22,0x90,0x22,0x90,0x21,0x10,
         0x21,0x10,0x22,0x90,0x22,0x90,0x24,0x50,
         0x28,0x50,0x30,0x12,0x40,0x0A,0x80,0x06,

   "?", 0x10,0x00,0x10,0x10,0x13,0xF8,0x10,0x00,
         0xFC,0x00,0x10,0x04,0x37,0xFE,0x38,0x40,
         0x54,0x40,0x51,0x50,0x91,0x48,0x12,0x4C,
         0x14,0x44,0x10,0x40,0x11,0x40,0x10,0x80,

   "?", 0x02,0x00,0x02,0x00,0x02,0x10,0x7F,0xF8,
         0x42,0x10,0x42,0x10,0x7F,0xF0,0x42,0x10,
         0x42,0x10,0x7F,0xF0,0x42,0x10,0x02,0x00,
         0x02,0x04,0x02,0x04,0x01,0xFC,0x00,0x00,

   "?", 0x00,0x00,0x3F,0xF0,0x00,0x10,0x00,0x20,
         0x00,0x40,0x01,0x80,0x01,0x04,0xFF,0xFE,
         0x01,0x00,0x01,0x00,0x01,0x00,0x01,0x00,
         0x01,0x00,0x01,0x00,0x05,0x00,0x02,0x00,

   "?", 0x02,0x00,0x02,0x04,0xFF,0xFE,0x04,0x00,
         0x04,0x10,0x0F,0xF8,0x08,0x10,0x18,0x10,
         0x2F,0xF0,0x48,0x10,0x88,0x10,0x0F,0xF0,
         0x08,0x10,0x08,0x10,0x08,0x50,0x08,0x20,

   "?", 0x00,0x08,0x7D,0xFC,0x45,0x08,0x49,0x08,
         0x49,0xF8,0x51,0x08,0x49,0x08,0x49,0xF8,
         0x45,0x04,0x45,0x88,0x45,0x50,0x69,0x20,
         0x51,0x10,0x41,0x4E,0x41,0x84,0x41,0x00,

   "?", 0x00,0x00,0x00,0x80,0x04,0x80,0x04,0x40,
         0x08,0x40,0x08,0x20,0x11,0x10,0x21,0x0E,
         0xC2,0x04,0x02,0x00,0x04,0x00,0x08,0x40,
         0x10,0x20,0x1F,0xF0,0x00,0x10,0x00,0x00,

   "?", 0x00,0x08,0x3F,0xFC,0x00,0x08,0x00,0x48,
         0xFF,0xE8,0x00,0x08,0x00,0x88,0x3F,0xC8,
         0x20,0x88,0x20,0x88,0x20,0x88,0x20,0x88,
         0x3F,0x88,0x20,0x88,0x00,0x28,0x00,0x10      
 };

// Bitmap table
// Picture: C:\..\Desktop\223.bmp
// Picture Size: 128 * 64    
uint8 const  nBitmapDot[] =                  // data table
 { 
	 0x00, 0x00, 0x00, 0x00, 0x00, 0x00, 0x00, 0x00, 0x00, 0x00, 0x00, 0x00,
	0x00, 0x00, 0x00, 0x00, 0x00, 0x00, 0x00, 0x00, 0x00, 0x00, 0x00, 0x00,
	0x00, 0x00, 0x00, 0x00, 0x00, 0x00, 0x00, 0x00, 0x00, 0x00, 0x00, 0x00,
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	0x00, 0x00, 0x00, 0x00, 0x00, 0x00, 0x00, 0x00, 0x00, 0x00, 0x00, 0x00
 };
 


/*---------------Delay function----------------*/
void delay (uint16 us)
 { while(us--);
 }

void delay1 (uint16 ms)
 { uint16 i,j;
   for(i=0;i<ms;i++)
   for(j=0;j<3000;j++)
      ;
 }

/*------------Write data or command to LCD--------------*/
void wr_od (uint8 dat,uint8 comm)       //write one byte data and one byte command
 { wr_data(dat);
   wr_comm(comm);
 }

void wr_td (uint8 datl,uint8 dath,uint8 comm)  //write two bytes data and one byte command
 { wr_data(datl);
   wr_data(dath);
   wr_comm(comm);
 }

void wr_xd (uint16 dat,uint8 comm)       //write a 16 bits data and one byte command
 { wr_data(dat);
   wr_data(dat>>8);
   wr_comm(comm);
 }

void wr_auto (uint8 dat)               //Auto write
 { chk_busy (1);
   IO0CLR=cd;
   IO0SET=rd;
   IO0PIN=(IO0PIN&0XFF00FFFF|(dat<<16));
   IO0CLR=wr;
   IO0SET=wr;
 }

void wr_comm (uint8 comm)       //write command
 { chk_busy (0);
   IO0SET=cd;
   IO0SET=rd;
   IO0PIN=(IO0PIN&0XFF00FFFF|(comm<<16));
   IO0CLR=wr;
   IO0SET=wr;
 }

void wr_data (uint8 dat)       //write data
 { chk_busy (0);
   IO0CLR=cd;
   IO0SET=rd;
   IO0PIN=(IO0PIN&0XFF00FFFF|(dat<<16));
   IO0CLR=wr;
   IO0SET=wr;
 }

void chk_busy (uint8 autowr)    //test busy flag
 { IO0SET=0xff;
   IO0SET=cd;
   IO0SET=wr;
   IO0DIR &= 0xFF00FFFF;
   IO0CLR=rd;
   if(autowr)
    { while((IO0PIN&(bf3<<16))==0);
    }
   else
    { while((IO0PIN&(bf0<<16))==0||(IO0PIN&(bf1<<16))==0);
    }
   IO0SET=rd;
   IO0DIR |= 0x00FF0000;
 }

/*--------------Clear RAM------------------*/
void clrram (void)
 { uint8 i,j;
   wr_xd(addr_w,0x24);
   wr_comm(0xb0);
   for(j=0;j<144;j++)
    { for(i=0;i<width;i++)
         wr_auto(0x00);
    }
   wr_comm(0xb2);
 }

/*--------------Display matrix------------------*/
void disp_dz (uint8 data1,uint8 data2)
 { uint8 i,j;
   wr_xd(addr_t,0x24);
   wr_comm(0xb0);
   for(j=0;j<64;j++)
    { for(i=0;i<width;i++)
         wr_auto(data1);
      for(i=0;i<width;i++)
         wr_auto(data2);
    }
   wr_comm(0xb2);
 }

/*--------------Draw a (8*l)*yl picture at addr-------------*/
void disp_img (uint8 addr,uint8 xl,uint8 yl,uint8 const *img)
 { uint8 i,j;
   for(j=0;j<yl;j++)
    { for(i=0;i<xl;i++)
       { wr_xd(addr+0X100+j*width+i,0x24);
         wr_od(img[j*xl+i],0xc0);
				
       }
    }
 }
 void disp_img_fliped (uint8 addr,uint8 xl,uint8 yl,uint8 const *img)
 { 
 uint8 i,j;
//   for(j=yl-1;j>0;j-=1)
//    { for(i=0;i<16;i+=1)
//			
//       { 
//			 wr_xd(addr+0X100+(yl-j-1)*width+(i),0x24);
//        wr_od(img[j*xl+i],0xc0);
//				 if(j==0)
//				 break;
//      }
//			 
//    }
		
 
   for(j=yl-1;j>0;j--)
    {  int b,k; 
			for(i=xl-1,k=0;i>0;i--,k++)
       { 
				  for(b=0;b<1000;b++);
				 wr_xd(addr+0X100+j*width+i,0x24);
         wr_od(img[j*xl+k],0xc0);
				
       }
			 for(b=0;b<10000;b++);
    }
			
			
		
    
		
 }

/*----------Draw a Chinese character at addr----------*/
void disp_chn (uint16 addr,uint8 xl,uint8 yl,uint8 row_xl,uint8 row_yl,uint8 const  *chn)
 { uint8 i,j,k,m;
   for(m=0;m<row_yl;m++)
    { for(k=0;k<row_xl;k++)
       { for(j=0;j<yl;j++)
          { for(i=0;i<xl;i++)
             { wr_xd(addr+m*yl*width+k*xl+j*width+i,0x24);
               wr_od(chn[(m*row_xl*xl*yl)+(k*xl*yl)+(j*xl)+i],0xc0);
             }
          }
       }
    }
 }

/*--------------Draw string------------------*/
void disp_eng (uint8 const *eng)
 {
	 uint8 i,j;
   wr_xd(addr_w,0x24);
   wr_comm(0xb0);
   for(j=0;j<10;j++)
    { for(i=0;i<width;i++)
         wr_auto(eng[j*width+i]);
    }
   wr_comm(0xb2);
 }

/*----------Draw a Chinese character at position (x,y)----------*/
void disp_hz(uint32 x,uint32 y,uint8  *str)
 { uint8 i,j,n,c1,c2,slen,m=0;
   uint32 tempx,tempy;
   tempx=x;
   tempy=y;
   slen = strlen((char const*)str);
  
	while(m<slen-1)
	 { c1=str[m+0];c2=str[m+1];
      for(n=0;n<sizeof(GB_16)/sizeof(GB_16[0]);n++)
       { if(c1 == GB_16[n].Index[0]&&c2 == GB_16[n].Index[1])
         break;
       }
      y=tempy;
      x=tempx;   
      for(i=0;i<16;i++)
       { for (j=0;j<2;j++)
          { wr_xd((0x0100+256*y+16*i+x+j),0x24);
            wr_od(GB_16[n].Msk[i*2+j],0xc0);    
          }
       }
      m=m+2;//one Chinese charecter has two bytes, LCDSIZE/8
      tempx += 2;
    
      if(tempx>15)
       { tempx = 0;
         tempy += 1;
       }
    }
 }

/*----------Draw a character at position (x,y)----------*/
void disp_zf(uint32 x,uint32 y,uint8 *str)
 { char c;
   wr_xd((addr_w+16*y+x),0x24);
   wr_comm(0xb0);
   while(*str!='\0')
    { c = (*str);
      wr_auto(c-32);
      str++;
    }
   wr_comm(0xb2);
 }
 void init_lcd (void)
 { 
	 IO0CLR=rst;
	 IO0SET=rst;
	 delay1(50);
	 IO0CLR=ce;
	 IO0SET=wr;
	 IO0SET=rd;
	 wr_xd(addr_w,0x40);									 // Set text display buffer base address
	 wr_xd(addr_t,0x42);									 // Set graphics display buffer base address
	 wr_td(width,0x00,0x41);							 // Set text display width
	 wr_td(width,0x00,0x43);							 // Set graphics display width
	 wr_comm(0x81);												// Set display mode: text xor graphics
	 wr_td(0x56,0x00,0x22);								// Set CGRAM offset address
	 wr_comm(0x9c);												// Set text and graphic display on
 }
 
 